## conf/layer.conf
```bitbake
# We have a conf and classes directory, append to BBPATH
BBPATH .= ":${LAYERDIR}"

# We have a recipes directory, add to BBFILES
BBFILES += "${LAYERDIR}/recipes*/*/*.bb ${LAYERDIR}/recipes*/*/*.bbappend"

BBFILE_COLLECTIONS += "meta-nanopi"
BBFILE_PATTERN_meta-nanopi := "^${LAYERDIR}/"
BBFILE_PRIORITY_meta-nanopi = "6"
```

## conf/machine/nanopi-m4.conf
```bitbake
#@TYPE: Machine
#@NAME: NanoPi-M4
#@DESCRIPTION: FriendlyARM NanoPi-M4 board based on RK3399
SOC_FAMILY = "rk3399"

#require conf/machine/include/tune-cortexa72.inc
require conf/machine/include/arm/arch-armv8.inc

require conf/machine/include/soc-family.inc

MACHINEOVERRIDES =. "mali-gpu:mali-midgard:"

PREFERRED_PROVIDER_virtual/bootloader ?= "u-boot-nanopi-m4"
UBOOT_MACHINE = "nanopi-m4-rk3399_defconfig"

PREFERRED_PROVIDER_virtual/kernel = "linux-nanopim4"

SERIAL_CONSOLES = "115200;ttyS2 115200;ttyS0"
KERNEL_IMAGETYPE = "Image"
KBUILD_DEFCONFIG = "nanopim4_working_defconfig"
KERNEL_DEVICETREE = "rockchip/rk3399-nanopi4-rev01.dtb"
KERNEL_DEVICETREE += "rockchip/rk3399-nanopi4-rev06.dtb"
KERNEL_DEVICETREE += "rockchip/rk3399-nanopi4-rev00.dtb"
KERNEL_DEVICETREE += "rockchip/rk3399-nanopi4-rev04.dtb"

MACHINE_ESSENTIAL_EXTRA_RRECOMMENDS += "\
    kernel-modules \
    kernel-devicetree \
    u-boot-nanopi-m4 \
    firmware-nanopi-m4 \
"

IMAGE_FSTYPES_append = " ext4.gz ext4"
UBI_VOLNAME = "rootfs"

IMAGE_FSTYPES += "nanopim4-gpt-img"
IMAGE_CLASSES += "nanopim4-gpt-img"

APPEND += "root=/dev/mmcblk0p1 earlyprintk console=ttyS2,115200n8 rw rootwait"
```

## conf/machine/nanopi.conf
```bitbake
#@TYPE: Machine
#@NAME: NanoPi
#@DESCRIPTION: FriendlyARM NanoPi board

require conf/machine/include/tune-arm926ejs.inc

KERNEL_IMAGETYPE = "zImage"

SERIAL_CONSOLE = "115200 ttyGS0"

MACHINE_DISPLAY_WIDTH_PIXELS = "320"
MACHINE_DISPLAY_HEIGHT_PIXELS = "240"
MACHINE_DISPLAY_ORIENTATION = "0"
MACHINE_DISPLAY_PPI = "110"
MACHINE_FEATURES = "kernel26 apm alsa usbgadget usbhost vfat screen touchscreen"
PREFERRED_PROVIDER_virtual/kernel = "linux-nanopi"

IMAGE_FSTYPES ?= "tar.bz2"
UBI_VOLNAME = "rootfs"
```
